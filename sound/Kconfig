## sound/Kconfig
```kconfig
# SPDX-License-Identifier: Apache-2.0
menuconfig SOUND
    bool "Sound support"
    default y

if SOUND
config SND
    tristate "ALSA and OSS sound core"
    default y
    help
      Linux-compatible ALSA/OSS character interfaces, card registry, PCM,
      control/mixer/timer operations and provider-owned user mappings.
      With M, build snd.ko for this exact ReliefNT kernel. Native hardware
      driver dependencies load it first. Open files, mapped PCM backing,
      registered cards and deferred disconnect work prevent unsafe unload.
endif
```

## tools/tests/kmodules/Kconfig
```kconfig
# SPDX-License-Identifier: Apache-2.0
menuconfig MODULE_TESTS
    bool "Native module developer tests"
    depends on MODULES
    default n
    help
      Opt-in test components. Production defconfig does not build them.

if MODULE_TESTS
config MODULE_TEST_PROVIDER
    tristate "Composite exported-symbol provider"
config MODULE_TEST_CONSUMER
    tristate "Export consumer"
    depends on MODULE_TEST_PROVIDER
config MODULE_TEST_INIT_FAIL
    tristate "Failed initialization test"
config MODULE_TEST_BUSY
    tristate "Lifetime test module"
config MODULE_TEST_STANDALONE
    tristate "Native address-space test module"
config MODULE_TEST_PARAMETERS
    tristate "Typed parameter test module"
endif
```

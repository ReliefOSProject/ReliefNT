## Kconfig
```kconfig
mainmenu "ReliefNT x86-64 Kernel Configuration"

config 64BIT
    bool
    default y

source "kernel/module/Kconfig"
source "kernel/sync/Kconfig"
source "sound/Kconfig"
source "drivers/Kconfig"
source "fs/Kconfig"

comment "Production subsystems default to built-in"
comment "Build policy: PROFILE=debug|release"
comment "Show build commands: V=1"
comment "Toolchain and version suffixes use Make variables"
comment "Configure applications and images in ReliefOS"
comment "QEMU options also belong to ReliefOS"
```

## drivers/Kconfig
```kconfig
# SPDX-License-Identifier: Apache-2.0
menu "Device drivers"
source "drivers/storage/Kconfig"
source "drivers/net/Kconfig"
source "drivers/sound/Kconfig"
source "drivers/input/Kconfig"
source "drivers/tty/Kconfig"
source "drivers/usb/Kconfig"
source "drivers/video/Kconfig"
endmenu
```

## drivers/input/Kconfig
```kconfig
# SPDX-License-Identifier: Apache-2.0
menu "Input device drivers"
source "drivers/input/mouse/Kconfig"
endmenu
```

## drivers/input/mouse/Kconfig
```kconfig
# SPDX-License-Identifier: Apache-2.0
config MOUSE_PS2
    tristate "PS/2 and VMware backdoor mouse"
    default y
    help
      Poll PS/2 packets and VMware absolute mouse events through the native
      input core. M builds mouse.ko. The permanent IRQ/input queue dispatch
      closes and drains callbacks before the mouse provider is removed.
```

## drivers/net/Kconfig
```kconfig
# SPDX-License-Identifier: Apache-2.0
menu "Network device drivers"
source "drivers/net/e1000/Kconfig"
source "drivers/net/e1000e/Kconfig"
source "drivers/net/r8169/Kconfig"
endmenu
```

## drivers/net/e1000/Kconfig
```kconfig
# SPDX-License-Identifier: Apache-2.0
config E1000
    tristate "Intel PRO/1000 (8254x, QEMU and VMware e1000)"
    default y
    help
      Native PCI Ethernet driver. With M, build e1000.ko for this ReliefNT
      kernel. Device registration, DMA STOP and callback drain use the same
      entry points for builtin and loadable configurations.
```

## drivers/net/e1000e/Kconfig
```kconfig
# SPDX-License-Identifier: Apache-2.0
config E1000E
    tristate "Intel PCIe Gigabit Ethernet (82574L/IT and 82583V)"
    default y
    help
      Native PCIe Ethernet for Intel 82574L/82574IT (8086:10d3) and 82583V
      (8086:150c), including QEMU's e1000e model. Other Intel e1000e-family
      controllers, such as I217/I219, are not bound by this driver.
      Uses the existing single eth0 network backend, coherent 64-bit DMA,
      full-duplex copper autonegotiation and bounded polling queues.
      With M, build e1000e.ko with native owner-aware DMA STOP and cleanup.
```

## drivers/net/r8169/Kconfig
```kconfig
# SPDX-License-Identifier: Apache-2.0
config R8169
	tristate "Realtek RTL8111/8168 and RTL8125 PCIe Ethernet"
	default y
	help
	  Native driver for supported Realtek RTL8111/8168 Gigabit and RTL8125
	  2.5 Gigabit PCIe Ethernet MAC revisions. Supports coherent DMA and
	  standard copper autonegotiation, with software protocol checksums.
	  Select M to build r8169.ko. The default configuration builds it in.
```

## drivers/sound/Kconfig
```kconfig
# SPDX-License-Identifier: Apache-2.0
menu "Sound device drivers"
source "drivers/sound/ac97/Kconfig"
source "drivers/sound/es1371/Kconfig"
source "drivers/sound/hda/Kconfig"
endmenu
```

## drivers/sound/ac97/Kconfig
```kconfig
# SPDX-License-Identifier: Apache-2.0
config SND_INTEL8X0
    tristate "Intel ICH AC97 playback"
    depends on SND
    default y
    help
      Native legacy OSS playback for Intel 8086:2415 AC97 controllers.
      With M, build ac97.ko for this kernel. Open OSS descriptions pin the
      provider; unload requires acknowledged STOP and disabled bus mastering.
```

## drivers/sound/es1371/Kconfig
```kconfig
# SPDX-License-Identifier: Apache-2.0
config SND_ENS1371
    tristate "Ensoniq ES1371 AudioPCI playback"
    depends on SND
    default y
    help
      Native legacy OSS playback for Ensoniq 1274:1371 AudioPCI controllers.
      With M, build es1371.ko for this kernel. Its 32-bit DMA pool and fallible
      STOP keep hardware resources owned until a safe unload can complete.
```

## drivers/sound/hda/Kconfig
```kconfig
# SPDX-License-Identifier: Apache-2.0
config SND_HDA_INTEL
    tristate "Intel/AMD High Definition Audio"
    depends on SND
    default y
    help
      Native PCI HDA controller, codec, PCM and mixer driver. The sound core
      retains provider code for open files and mappings. With M, build hda.ko
      for this ReliefNT kernel; an absent controller leaves it unbound.
```

## drivers/storage/Kconfig
```kconfig
# SPDX-License-Identifier: Apache-2.0
menu "Block device transports"
config SATA_AHCI
	tristate "AHCI SATA and ATAPI block devices"
	default y
	help
	  Native AHCI ATA/ATAPI transport. Module name: ahci.
config PATA_IDE
	tristate "PCI IDE ATA and ATAPI PIO block devices"
	default y
	help
	  Native PCI IDE CPU-PIO transport. Module name: ide.
config BLK_DEV_NVME
	tristate "NVMe PCI block devices"
	default y
	help
	  Native NVMe PCI transport with owned queues/PRPs. Module name: nvme.
endmenu
```

## drivers/tty/Kconfig
```kconfig
# SPDX-License-Identifier: Apache-2.0
menu "TTY device drivers"
source "drivers/tty/serial/Kconfig"
endmenu
```

## drivers/tty/serial/Kconfig
```kconfig
# SPDX-License-Identifier: Apache-2.0
config SERIAL_8250
    tristate "16550 COM1 serial provider"
    default y
    help
      Native polled COM1 serial output. M builds serial.ko. The permanent TTY
      and emergency serial core keep working when the optional provider is
      absent; its service calls are pinned until the final byte is written.
```

## drivers/usb/Kconfig
```kconfig
# SPDX-License-Identifier: Apache-2.0
menu "USB host drivers"
source "drivers/usb/ehci/Kconfig"
source "drivers/usb/uhci/Kconfig"
source "drivers/usb/xhci/Kconfig"
endmenu
```

## drivers/usb/ehci/Kconfig
```kconfig
# SPDX-License-Identifier: Apache-2.0
config USB_EHCI_HCD
    tristate "EHCI USB 2.0 storage and HID host controller"
    default y
    help
      PCI EHCI high-speed USB2, Bulk-Only SCSI flash storage and boot HID
      keyboard/mouse, including USB2 hub transaction translators.
      Low/full-speed root-port devices require a UHCI companion controller;
      enable USB_UHCI_HCD for VMware's USB2 controller. M builds ehci.ko.
      This is an EHCI driver, not support for USB2 ports owned by xHCI.
```

## drivers/usb/uhci/Kconfig
```kconfig
# SPDX-License-Identifier: Apache-2.0
config USB_UHCI_HCD
    tristate "UHCI USB HID host controller"
    default y
    help
      Native PCI UHCI and boot HID keyboard/mouse support. M builds uhci.ko.
      All schedule/transfer DMA comes from explicit 32-bit coherent backing;
      permanent USB input dispatch drains callbacks before hardware teardown.
```

## drivers/usb/xhci/Kconfig
```kconfig
# SPDX-License-Identifier: Apache-2.0
config USB_XHCI_HCD
    tristate "xHCI USB host controller"
    default y
    help
      PCI xHCI host for SuperSpeed Bulk-Only SCSI storage and USB2/1.x
      Bulk-Only storage and boot HID keyboard/mouse, directly or through
      USB2/USB3 hubs. Supports hub status interrupts, TT routes and hotplug.
      M builds xhci.ko. Streams, isochronous endpoints and UAS are unsupported.
```

## drivers/video/Kconfig
```kconfig
# SPDX-License-Identifier: Apache-2.0
config DRM
    tristate "DRM/KMS for the VMware SVGA framebuffer"
    default y
    help
      Linux DRM and vmwgfx userspace interfaces for the VMware SVGA II
      function already bound by the boot framebuffer. Selecting M builds
      drm.ko. Device discovery and publication occur when the module loads;
      the early framebuffer and console remain permanent kernel services.
      Open card/PRIME descriptors, mappings, asynchronous jobs, resources and
      hardware callbacks retain the exact module until safely retired.
```

## fs/Kconfig
```kconfig
# SPDX-License-Identifier: Apache-2.0
menu "Filesystems"

config FAT_FS
    tristate "FAT32 filesystem and formatter"
    default y
    help
      Native FAT32 filesystem, including EFI system partitions. Choose M to
      build vfat.ko; early boot must load it before mounting a FAT root or ESP.

config EXFAT_FS
    tristate "exFAT filesystem and formatter"
    default y

config EXT_FS_COMMON
    tristate

config EXT2_FS
    tristate "ext2 filesystem and formatter"
    default y
    select EXT_FS_COMMON
    help
      Register the ext2 filesystem using ReliefNT's shared native ext engine.
      The shared ext_common module contains the actual format, allocation,
      journal, cache and inode implementation used by both ext frontends.

config EXT4_FS
    tristate "ext4 filesystem and formatter"
    default y
    select EXT_FS_COMMON

config ISO9660_FS
    tristate "ISO9660 read-only filesystem"
    default y

comment "Initial memory root, tmpfs, VFS and proc/sys/dev filesystems stay built-in"
endmenu
```

## kernel/module/Kconfig
```kconfig
# SPDX-License-Identifier: Apache-2.0
menu "Loadable module support"

config MODULES
    bool "Enable loadable kernel modules"
    modules
    default y
    help
      Build eligible components as native ReliefNT ELF modules when set to M.
      The default configuration keeps production components built in.
      Modules must match this kernel's build and exported interface versions.

config MODULE_UNLOAD
    bool "Module unloading"
    depends on MODULES
    default y
    help
      Permit unloading modules after their users and callbacks have drained.
      In-use modules cannot be forcibly unloaded.

config MODVERSIONS
    bool
    depends on MODULES
    default y

source "tools/tests/kmodules/Kconfig"

endmenu
```

## kernel/sync/Kconfig
```kconfig
config LOCK_STAT
    bool "ReliefNT execution gate profiling"
    default n
    help
      Build the optional /proc/reliefnt/lock_stats diagnostic. Collection
      remains disabled until explicitly enabled by an administrator.
```

## mm/Kconfig
```kconfig
# SPDX-License-Identifier: Apache-2.0
config SWAP
    bool "Swap support"
    default y
    help
      Build core swap area accounting and the fixed-block backing interface.
```

## drivers/net/i225/Kconfig
```kconfig
# SPDX-License-Identifier: Apache-2.0
config I225_V
    tristate "Intel I225-V / I226-V 2.5GbE Ethernet"
    default y
    help
      Native PCIe Ethernet for Intel I225-V (8086:15f3) and I226-V
      (8086:125c). The driver uses one RX/TX queue and the existing network
      device interface. MSI notifies the network service when available;
      otherwise the driver uses polling.
      Frame processing always runs in task context.
      Other I225 and I226 variants are not matched. Builds i225.ko when modular.
```

## drivers/net/rtl8139/Kconfig
```kconfig
# SPDX-License-Identifier: Apache-2.0
config RTL8139
    tristate "Realtek RTL8139 10/100 PCI Ethernet (classic mode)"
    default y
    help
      Native driver for PCI 10ec:8139, including the QEMU RTL8139 model.
      Uses the I/O BAR, DMA32 receive ring and four transmit buffers, with
      task-context polling and device interrupts masked. Each PCI function
      registers a separate interface. M builds rtl8139.ko for this kernel.
      C+ descriptor mode, hardware offloads and shared INTx are not enabled.
```

## drivers/net/vmxnet3/Kconfig
```kconfig
# SPDX-License-Identifier: Apache-2.0
config VMXNET3
    tristate "VMware VMXNET3 Ethernet"
    default y
    help
      Native VMware VMXNET3 (15ad:07b0) Ethernet using revision 1 and UPT 1,
      one TX and RX queue, and software protocol checksums. Each PCI function
      registers an independent NIC with the existing network stack.
      With M, build vmxnet3.ko with owner-aware STOP and cleanup.
```

## drivers/tty/serial/Kconfig
```kconfig
# SPDX-License-Identifier: Apache-2.0
config SERIAL_8250
    tristate "16550 COM1 serial provider"
    default y
    help
      Register the built-in COM1 transmitter with the driver manager. M
      builds serial.ko. The serial queue and the early and emergency polling
      paths keep working when this optional provider is absent.
```

## drivers/video/Kconfig
```kconfig
# SPDX-License-Identifier: Apache-2.0
config DRM
    tristate "DRM/KMS graphics"
    default y
    help
      Linux DRM/KMS with an optional VirtIO-GPU backend. Selecting M builds
      drm.ko. Device discovery and publication occur when the module loads;
      the early framebuffer and console remain permanent kernel services.
      Open card/PRIME descriptors, mappings, asynchronous jobs, resources and
      hardware callbacks retain the exact module until safely retired.

config DRM_VIRTIO_GPU
    bool "VirtIO-GPU 2D and VirGL DRM/KMS"
    depends on DRM && VIRTIO_PCI
    default y
    help
      Modern VirtIO PCI GPU support, Linux VirtGPU GEM/ioctls, KMS,
      hardware cursor and VirGL rendering with an unmodified Mesa driver.
      Included in drm.ko when DRM is modular. Venus and host-visible blob
      resources are not advertised by this configuration.

config DRM_VMWARE_SVGA
    bool "VMware SVGA II DRM/KMS (experimental)"
    depends on DRM
    help
      Support the VMware SVGA II PCI graphics adapter. The driver is included
      in drm.ko when DRM is modular. A supported VirtIO-GPU takes priority
      when both backends are configured and their devices are present.
```

## drivers/virtio/Kconfig
```kconfig
# SPDX-License-Identifier: Apache-2.0
config VIRTIO_PCI
    bool "Modern VirtIO PCI transport"
    default y
    help
      VirtIO 1.x PCI capabilities, coherent split queues and MSI-X/MSI.
      Transport stays built in; device providers may be loadable modules.
```

## fs/Kconfig
```kconfig
# SPDX-License-Identifier: Apache-2.0
menu "Filesystems"

config FAT_FS
    tristate "FAT32 filesystem and formatter"
    default y
    help
      Native FAT32 filesystem, including EFI system partitions. Choose M to
      build vfat.ko; early boot must load it before mounting a FAT root or ESP.

config EXFAT_FS
    tristate "exFAT filesystem and formatter"
    default y

config EXT_FS_COMMON
    tristate

config EXT2_FS
    tristate "ext2 filesystem and formatter"
    default y
    select EXT_FS_COMMON
    help
      Register the ext2 filesystem using ReliefNT's shared native ext engine.
      The shared ext_common module contains the actual format, allocation,
      journal, cache and inode implementation used by the ext frontends.

config EXT3_FS
    tristate "ext3 journaled filesystem and formatter"
    default y
    select EXT_FS_COMMON
    help
      Register ext3 using the shared native ext engine and ordered JBD
      metadata transactions. Choose M to build ext3.ko. The shared engine
      uses the highest linkage level selected by the enabled ext frontends.

config EXT4_FS
    tristate "ext4 filesystem and formatter"
    default y
    select EXT_FS_COMMON

config ISO9660_FS
    tristate "ISO9660 read-only filesystem"
    default y

config SQUASHFS
    bool "SquashFS 4.0 read-only filesystem (gzip)"
    default y
    help
      Mount gzip-compressed or uncompressed SquashFS 4.0 images without
      fragments or extended attributes. ReliefOS installer media require
      this filesystem built into the kernel.

comment "Initial memory root, tmpfs, VFS and proc/sys/dev filesystems stay built-in"
endmenu
```

## kernel/seccomp/Kconfig
```kconfig
config SECCOMP_FILTER
    bool "Seccomp classic BPF syscall filters"
    default y
    help
      Allow native x86-64 userspace to restrict the system calls of a thread
      or its thread group with classic BPF. Filters persist across fork and
      exec. See Documentation/userspace-api/seccomp.rst for the ABI scope.
```
